## firmware/components/ble_console/Kconfig
```kconfig
menu "Nordic Bluetooth client"
    config NORDIC_BLE
        bool "Enable Nordic BLE adapter"
        depends on BT_NIMBLE_ENABLED
        default n
        help
            Requires NimBLE, Secure Connections only, two connections and NVS
            bond persistence. Use ble.defaults together with local board defaults.
    config NORDIC_BLE_NO_PIN_TEST
        bool "Use PIN-free BLE pairing for bench testing"
        depends on NORDIC_BLE && NORDIC_SOFTWARE_TEST
        default n
        help
            Use encrypted, bonded Secure Connections Just Works pairing without
            a PIN or USB enrollment window. Nearby devices can pair while this
            test image is installed. Disable after unloaded bench testing.
endmenu
```

## firmware/components/relay_control/Kconfig
```kconfig
menu "Nordic relay control mapping (unloaded bench only)"
    config NORDIC_RELAY_CONTROL
        bool "Connect existing web controls to physical relays"
        depends on IDF_TARGET_ESP32S3 && NORDIC_SOFTWARE_TEST
        default n
    if NORDIC_RELAY_CONTROL
    config NORDIC_RELAY_START
        int "Start pulse relay (0 disables)"
        range 0 8
        default 1
    config NORDIC_RELAY_STOP
        int "Stop pulse relay (0 disables)"
        range 0 8
        default 6
    config NORDIC_RELAY_SPEED_UP
        int "Speed increase relay (0 disables)"
        range 0 8
        default 2
    config NORDIC_RELAY_SPEED_DOWN
        int "Speed decrease relay (0 disables)"
        range 0 8
        default 3
    config NORDIC_RELAY_INCLINE_UP
        int "Incline increase relay (0 disables)"
        range 0 8
        default 4
    config NORDIC_RELAY_INCLINE_DOWN
        int "Incline decrease relay (0 disables)"
        range 0 8
        default 5
    config NORDIC_RELAY_PULSE_MS
        int "Button pulse duration (milliseconds)"
        range 100 2000
        default 500
    endif
endmenu
```

## firmware/components/web_console/Kconfig
```kconfig
menu "Nordic Wi-Fi status page"
    config NORDIC_AP_SSID
        string "Access point name"
        default "Nordic-Ski-Setup"
    config NORDIC_AP_PASSWORD
        string "Access point password (8-63 printable ASCII characters)"
        default ""
        help
            Empty disables Wi-Fi. Set locally before flashing.
            This value is stored in the firmware image. Do not publish the
            configured sdkconfig or firmware binaries containing your password.
endmenu
```
